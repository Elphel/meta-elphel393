## conf/layer.conf
```bitbake
# We have a conf and classes directory, add to BBPATH
BBPATH .= ":${LAYERDIR}"

# We have recipes-* directories, add to BBFILES
BBFILES += "${LAYERDIR}/recipes-*/*/*.bb ${LAYERDIR}/recipes-*/*/*.bbappend"

BBFILE_COLLECTIONS += "elphel393"
BBFILE_PATTERN_elphel393 = "^${LAYERDIR}/"
BBFILE_PRIORITY_elphel393 = "8"

# This should only be incremented on significant changes that will
# cause compatibility issues with other layers
LAYERVERSION_elphel393 = "1"

LAYERDEPENDS_elphel393 = "core"

LAYERSERIES_COMPAT_elphel393 = "warrior"
```

## conf/machine/elphel393.conf
```bitbake
#@TYPE: Machine
#@NAME: elphel393
#@DESCRIPTION: Machine support for elphel393.
#              http://www.elphel.com/ 

require include/tune-zynq.inc
require include/machine-xilinx-default.inc

# Corresponding from linux-xlnx and ezynq-u-boot
PREFERRED_VERSION_ezynq-u-boot = "v2016.01%"
PREFERRED_VERSION_linux-xlnx = "4.%"

# Machine definition known by ezynq and xilinx u-boot
UBOOT_MACHINE = "elphel393_config"

SERIAL_CONSOLE = "115200 ttyPS0"

MACHINE_DEVICETREE := "\
                       elphel393/elphel393_mmc.dts \
                       elphel393/elphel393_nand.dts \
                      "
MACHINE_KCONFIG := "common/elphel393_defconfig_${LINUX_VERSION}"

#hostname - applied to rootfs image
hostname_pn-base-files = "elphel393"

PRODUCTION_ROOT_LOCATION := "mmc nand"
PRODUCTION_DIR        := "mmc"
PRODUCTION_BOOT       := "boot.bin"
PRODUCTION_UBOOT      := "u-boot-dtb.img"
PRODUCTION_DEVICETREE := "devicetree.dtb"
PRODUCTION_KERNEL     := "uImage"
PRODUCTION_ROOTFS     := "rootfs"
```

## conf/machine/include/machine-xilinx-default.inc
```bitbake
# Default Xilinx BSP Machine settings

# File System Configuration
# IMAGE_FSTYPES ?= "cpio tar.gz ext2 ext2.gz.u-boot ext2.gz"
IMAGE_FSTYPES ?= "ext2.gz.u-boot ext2"
#IMAGE_CLASSES += "image_types_uboot"

# Kernel Configuration
PREFERRED_PROVIDER_virtual/kernel ?= "linux-xlnx"
PREFERRED_VERSION_linux-xlnx ?= "4.%"

# U-Boot Configuration
PREFERRED_PROVIDER_virtual/bootloader ?= "u-boot-ezynq"
PREFERRED_PROVIDER_u-boot ?= "u-boot-ezynq"
PREFERRED_VERSION_u-boot-ezynq ?= "v2016.0%"

#PREFERRED_PROVIDER_virtual/bootloader ?= "u-boot-fw-utils"
#PREFERRED_PROVIDER_u-boot ?= "u-boot-fw-utils"

MACHINE_ESSENTIAL_EXTRA_RDEPENDS_append_zynq += "device-tree"
```

## conf/machine/microzed.conf
```bitbake
#@TYPE: Machine
#@NAME: microzed
#@DESCRIPTION: Machine support for microzed.
#              http://www.elphel.com/ 

require include/tune-zynq.inc
require include/machine-xilinx-default.inc

# Corresponding from linux-xlnx and ezynq-u-boot
PREFERRED_VERSION_ezynq-u-boot = "v2016.01%"
PREFERRED_VERSION_linux-xlnx = "4.%"

# microzed machine definition known by ezynq and probably xilinx u-boot
UBOOT_MACHINE = "zynq_microzed_config"

SERIAL_CONSOLE = "115200 ttyPS0"

MACHINE_DEVICETREE := "common/zynq-base.dtsi microzed/microzed.dtsi microzed/microzed.dts"
#KERNEL_DEVICETREE := "${MACHINE_DEVICETREE}"

#Copy of zedboard's defconfig
MACHINE_KCONFIG := "common/microzed_defconfig_${LINUX_VERSION}"

IMAGE_BOOT_FILES += "boot.bin ${MACHINE}.dtb"
```

## conf/machine/zc706.conf
```bitbake
#@TYPE: Machine
#@NAME: zc706
#@DESCRIPTION: Machine support for zc706.
#              http://www.elphel.com/ 

require include/tune-zynq.inc
require include/machine-xilinx-default.inc

# Corresponding from linux-xlnx and ezynq-u-boot
PREFERRED_VERSION_ezynq-u-boot = "v2016.01%"
PREFERRED_VERSION_linux-xlnx = "4.%"

# ZC706 machine definition known by ezynq and xilinx u-boot
UBOOT_MACHINE = "zynq_zc706_config"

SERIAL_CONSOLE = "115200 ttyPS0"

MACHINE_DEVICETREE := "common/zynq-base.dtsi zc706/zynq-zc706.dtsi zc706/zynq-zc706.dts"

#Copy of zedboard's defconfig
MACHINE_KCONFIG := "common/microzed_defconfig_${LINUX_VERSION}.cfg"
```

## conf/machine/zedboard.conf
```bitbake
#@TYPE: Machine
#@NAME: zedboard
#@DESCRIPTION: Machine support for zedboard.
#              http://www.elphel.com/ 

require include/tune-zynq.inc
require include/machine-xilinx-default.inc

# Corresponding from linux-xlnx and ezynq-u-boot
PREFERRED_VERSION_ezynq-u-boot = "v2016.01%"
PREFERRED_VERSION_linux-xlnx = "4.%"

# Zedboard machine definition known by ezynq and xilinx u-boot
UBOOT_MACHINE = "zynq_zed_config"

SERIAL_CONSOLE = "115200 ttyPS0"

MACHINE_DEVICETREE := "common/zynq-base.dtsi zedboard/zynq-zed.dts zedboard/zynq-zed.dtsi"

MACHINE_KCONFIG := "common/microzed_defconfig_${LINUX_VERSION}.cfg"
```
